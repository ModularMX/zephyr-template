## west.yml
```yaml
manifest:
  # lowest version of the manifest file schema that can parse this file’s data
  version: 0.8

  self:
    path: app
    
  projects:
    - name: zephyr
      # indicate the zephyr version we will use
      revision: v4.1.0
      # point to official github repo
      url: https://github.com/zephyrproject-rtos/zephyr
      # place zephyr source code into a directory called deps
      import:
        path-prefix: deps
        name-allowlist:
          # placehere all the packages you want to import
```
